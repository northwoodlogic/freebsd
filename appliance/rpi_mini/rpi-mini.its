## appliance/rpi_mini/rpi-mini.its
```
/dts-v1/;

/ {
	description = "RPI-B";
	#address-cells = <1>;

	images {
		kernel@1 {
/*
 * U-Boot decompresses the kernel on extraction to load address. Compression shrinks
 * the image down by about 6MB. FreeBSD is compatible with the linux ARM boot ABI and
 * will work with the bootm command.
 */
			data = /incbin/("armv6-mini.kernel/boot/kernel/kernel.gz");
			type = "kernel";
			arch = "arm";
			os = "linux";
			compression = "gzip";
/*
 * FreeBSD kernel on ARM can load on any 2MB boundry. Readelf shows the entrypoint
 * is 0x100 bytes in from the load address.
 */
			load  = <0x00200000>;
			entry = <0x00200100>;
			hash@1 {
				algo = "md5";
			};
		};
		fdt@1 {
			description = "vanilla";
			data = /incbin/("armv6-mini.kernel/boot/dtb/rpi.dtb");
			type = "flat_dt";
			arch = "arm";
			compression = "none";
			hash@1 {
				algo = "md5";
			};
		};
		fdt@2 {
			description = "purple";
			data = /incbin/("armv6-mini.kernel/boot/dtb/rpi-purple.dtb");
			type = "flat_dt";
			arch = "arm";
			compression = "none";
			hash@1 {
				algo = "md5";
			};
		};
		fdt@3 {
			description = "ksvfgpio";
			data = /incbin/("armv6-mini.kernel/boot/dtb/rpi-ksvfgpio.dtb");
			type = "flat_dt";
			arch = "arm";
			compression = "none";
			hash@1 {
				algo = "md5";
			};
		};
		fdt@4 {
			description = "opto22g4";
			data = /incbin/("armv6-mini.kernel/boot/dtb/rpi-opto22g4.dtb");
			type = "flat_dt";
			arch = "arm";
			compression = "none";
			hash@1 {
				algo = "md5";
			};
		};
	};

	configurations {
		rpi {
			fdt = "fdt@1";
			kernel = "kernel@1";
		};
		purple {
			fdt = "fdt@2";
			kernel = "kernel@1";
		};
		ksvf {
			fdt = "fdt@3";
			kernel = "kernel@1";
		};
		opto22g4 {
			fdt = "fdt@4";
			kernel = "kernel@1";
		};
	};
};
```
